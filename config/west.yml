## config/west.yml
```yaml
manifest:
  remotes:
    - name: zmkfirmware
      url-base: https://github.com/zmkfirmware
    - name: badjeff
      url-base: https://github.com/badjeff
    # - name: englmaxi
    #   url-base: https://github.com/englmaxi
    - name: carrefinho                            # <--- add this
      url-base: https://github.com/carrefinho     # <--- and this
    # Additional modules containing boards/shields/custom code can be listed here as well
    # See https://docs.zephyrproject.org/3.2.0/develop/west/manifest.html#projects
    #add prospector screen feath
    - name: janpfischer
      url-base: https://github.com/janpfischer
    - name: prospector
      url-base: https://github.com/t-ogura
  projects:
    - name: zmk
      remote: zmkfirmware
      revision: 4ec69cb
      import: app/west.yml
      #add display viev
    # - name: zmk-dongle-display
    #   remote: englmaxi
    #   revision: main
   - name: prospector-zmk-module                 # <--- and these
     remote: carrefinho                          # <---
     revision: 67425b7                              # <---
    #- name: zmk
      #remote: petejohanson
      #revision: feat/pointers-move-scroll
      #import: app/west.yml
    - name: zmk-pmw3610-driver
      remote: badjeff
      revision: 77635ba
    - name: zmk-split-peripheral-input-relay
      remote: badjeff
      revision: f49a5ca
    - name: zmk-input-behavior-listener
      remote: badjeff
      revision: 80fc270
    #add prospector screen feath
    - name: zmk-dongle-screen
      remote: janpfischer
      revision: 3311b96
    #add prospector screen with feath
    - name: prospector-zmk-module
      remote: prospector
      revision: 19ab80f
      path: modules/prospector-zmk-module
  self:
    path: config
```
